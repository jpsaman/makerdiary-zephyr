## boards/arm/nrf52832_mdk/Kconfig
```kconfig
# Kconfig - nRF52832-MDK board configuration
#
# Copyright (c) 2018 Zaowubang, Inc.
#
# SPDX-License-Identifier: Apache-2.0

if BOARD_NRF52832_MDK

config  GPIO_AS_PINRESET
	bool "GPIO as pin reset (reset button)"
	default y

endif # BOARD_NRF52832_MDK
```

## boards/arm/nrf52832_mdk/Kconfig.defconfig
```kconfig
# Kconfig - nRF52832-MDK board configuration
#
# Copyright (c) 2018 makerdiary.com.
#
# SPDX-License-Identifier: Apache-2.0

if BOARD_NRF52832_MDK

config BOARD
	default "nrf52832_mdk"

if UART_NRFX

config UART_0_NRF_TX_PIN
	default 20

config UART_0_NRF_RX_PIN
	default 19

config UART_0_NRF_RTS_PIN
	default 5

config UART_0_NRF_CTS_PIN
	default 7

endif # UART_NRFX

endif # BOARD_NRF52832_MDK
```

## boards/arm/nrf52840_mdk/Kconfig.defconfig
```kconfig
# Kconfig - nRF52840-MDK board configuration
#
# Copyright (c) 2018 makerdiary.com
#
# SPDX-License-Identifier: Apache-2.0

if BOARD_NRF52840_MDK

config BOARD
	default "nrf52840_mdk"

if UART_NRFX

config UART_0_NRF_TX_PIN
	int
	default 20

config UART_0_NRF_RX_PIN
	int
	default 19

config UART_0_NRF_RTS_PIN
	int
	default 5

config UART_0_NRF_CTS_PIN
	int
	default 7

if MODEM_WNCM14A2A

config UART_1_NRF_TX_PIN
	int
	default 16

config UART_1_NRF_RX_PIN
	int
	default 15

config UART_1_NRF_RTS_PIN
	int
	default 14

config UART_1_NRF_CTS_PIN
	int
	default 17

endif # MODEM_WCN14A2A

endif # UART_NRFX

if USB

config USB_NRF52840
	def_bool y

config USB_DEVICE_STACK
	def_bool y

endif # USB

if IEEE802154

config IEEE802154_NRF5
	def_bool y

endif # IEEE802154

endif # BOARD_NRF52840_MDK
```
